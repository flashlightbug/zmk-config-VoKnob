#include <behaviors.dtsi>
#include <dt-bindings/zmk/keys.h>
#include <dt-bindings/zmk/bt.h>
#include <dt-bindings/zmk/outputs.h>

/ {
    keymap {
        compatible = "zmk,keymap";

        default_layer {
            bindings = <
                &kp C_PP  //&kp M is not working either  //&kp C_MUTE is not working. It overrides the twist
                &kp K_MUTE2  //&kp K_MUTE // K_MUTE does not work
            >;
            sensor-bindings = <
                               &inc_dec_kp C_VOL_DN C_VOL_UP
                               &inc_dec_kp RIGHT LEFT
                               >;
        };
    };
};
